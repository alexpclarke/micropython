## ports/zephyr/boards/lpcxpresso55s69_cpu0.conf
```kconfig
CONFIG_NETWORKING=n
CONFIG_BT=n


# ----- Flash & LittleFS settings ----- #

CONFIG_FLASH=y
CONFIG_FLASH_MAP=y
CONFIG_FLASH_PAGE_LAYOUT=y

CONFIG_FILE_SYSTEM=y
CONFIG_FILE_SYSTEM_LITTLEFS=y

CONFIG_FS_LITTLEFS_READ_SIZE=16
CONFIG_FS_LITTLEFS_PROG_SIZE=512
CONFIG_FS_LITTLEFS_CACHE_SIZE=512
CONFIG_FS_LITTLEFS_LOOKAHEAD_SIZE=32
CONFIG_FS_LITTLEFS_BLOCK_CYCLES=512

# CONFIG_MICROPY_VFS=y
CONFIG_MICROPY_VFS_FAT=n
CONFIG_MICROPY_VFS_LFS1=n
CONFIG_MICROPY_VFS_LFS2=y




# ----- LOGGING ----- #

CONFIG_LOG=y
CONFIG_LOG_MODE_MINIMAL=y
```
